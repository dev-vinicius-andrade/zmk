## app/src/split/Kconfig
```kconfig
#Copyright(c) 2022 The ZMK Contributors
#SPDX - License - Identifier : MIT

menuconfig ZMK_SPLIT bool "Split keyboard support"

    if ZMK_SPLIT

        config ZMK_SPLIT_ROLE_CENTRAL bool "Split central device"

    config ZMK_SPLIT_BLE bool "BLE Split" default y depends on ZMK_BLE select BT_USER_PHY_UPDATE
        select BT_AUTO_PHY_UPDATE

            config ZMK_SPLIT_WIRED bool "Wired Split" default y if !ZMK_SPLIT_BLE depends on
                DT_HAS_ZMK_WIRED_SPLIT_ENABLED select SERIAL select RING_BUFFER select CRC

                    config
                        ZMK_SPLIT_PERIPHERAL_HID_INDICATORS bool "Peripheral HID Indicators" depends
                            on ZMK_HID_INDICATORS help Enable propagating the
                            HID(LED)
Indicator state to the split peripheral(s).

    config ZMK_MAX_KNOWN_CENTRALS
    int "Maximum number of known bonded centrals" default 5 help Determines how many central(dongle) MAC addresses should be remembered
      and cycled through for reconnection.
	  
config ZMK_STATIC_MAC_ADDRESS
    string "Static MAC address"
    default ""
    help
      Optional static random Bluetooth MAC address in the format C0:FF:EE:C0:DE:01.
      If set, the central or peripheral will use this instead of the default MAC.

endif # ZMK_SPLIT

rsource "bluetooth/Kconfig"
rsource "wired/Kconfig"
```

## app/src/split/Kconfig.defaults
```kconfig
# Copyright (c) 2024 The ZMK Contributors
# SPDX-License-Identifier: MIT
CONFIG_CONFIG_ZMK_MAX_KNOWN_CENTRALS=5
rsource "bluetooth/Kconfig.defaults"
rsource "wired/Kconfig.defaults"
```
